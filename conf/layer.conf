## conf/layer.conf
```bitbake
# We have a conf and classes directory, add to BBPATH
BBPATH .= ":${LAYERDIR}"

# We have recipes-* directories, add to BBFILES
BBFILES += "${LAYERDIR}/recipes-*/*/*.bb \
            ${LAYERDIR}/recipes-*/*/*.bbappend"

BBFILE_COLLECTIONS += "meta-lumi-mieu01"
BBFILE_PATTERN_meta-lumi-mieu01 = "^${LAYERDIR}/"
BBFILE_PRIORITY_meta-lumi-mieu01 = "6"

LAYERDEPENDS_meta-lumi-mieu01 = "core"
LAYERSERIES_COMPAT_meta-lumi-mieu01 = "warrior zeus"
```

## conf/machine/imx6ull-lumi-mieu01.conf
```bitbake
#@TYPE: Machine
#@NAME: Lumi gateway mieu01 
#@SOC: i.MX6ULL
#@DESCRIPTION: Machine configuration for Xiaomi/Aquara smart home gateway with i.MX6ULL SOC
#@MAINTAINER: Anatoliy Shipitsyn <norguhtar@gmail.com>

MACHINEOVERRIDES =. "mx6:mx6ull:"

include conf/machine/include/imx-base.inc
include conf/machine/include/tune-cortexa7.inc

KERNEL_DEVICETREE = "imx6ull-14x14-evk.dtb"

PREFERRED_PROVIDER_u-boot = "u-boot-imx"
PREFERRED_PROVIDER_virtual/bootloader = "u-boot-imx"
PREFERRED_PROVIDER_virtual/kernel = "linux-imx"

UBOOT_CONFIG ??= "nand"
UBOOT_CONFIG[nand] = "mx6ull_lm16_igw_defconfig"
UBOOT_CONFIG[mfgtool] = "mx6ull_lm16_igw_defconfig"

SERIAL_CONSOLES = "115200;ttymxc0"

MACHINE_FEATURES += "wifi bluetooth usbgadget usbhost vfat ext2 alsa"
```
